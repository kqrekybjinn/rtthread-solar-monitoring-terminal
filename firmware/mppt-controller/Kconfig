## firmware/mppt-controller/Kconfig
```kconfig
mainmenu "RT-Thread Configuration"

BSP_DIR := .

RTT_DIR := rt-thread

PKGS_DIR := packages

config SOC_STM32G474RE
    bool
    select SOC_SERIES_STM32G4
    select RT_USING_COMPONENTS_INIT
    select RT_USING_USER_MAIN
    default y

config BOARD_STM32G474_NUCLEO
    bool
    select BOARD_SERIES_STM32_NUCLEO_64
    default y

config PLATFORM_DIR
    string
    option env="PLATFORM_DIR"
    default  "D:/Users/Desktop/ws/workspaceing/qiansai26/third_party/rt-thread/bsp/stm32/stm32g474-st-nucleo/platform"

config RTT_DIR
    string
    option env="RTT_DIR"
    default  "D:/Users/Desktop/ws/workspaceing/qiansai26/third_party/rt-thread/bsp/stm32/stm32g474-st-nucleo/rt-thread"

config PKGS_DIR
    string
    option env="PKGS_DIR"
    default "E:/toolchain/RT-Thread/RT-ThreadStudio/platform/env_released/env/packages"

source "$(RTT_DIR)/Kconfig"
osource "$PKGS_DIR/Kconfig"
rsource "libraries/Kconfig"

if !RT_USING_NANO
rsource "board/Kconfig"
endif
```
